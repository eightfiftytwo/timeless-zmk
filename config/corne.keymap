#define CONFIG_WIRELESS 1
#include "base.keymap"

// // Blank 6col template
// // ╭─────────────┬─────────────┬─────────────┬─────────────┬─────────────┬─────────────╮   ╭─────────────┬─────────────┬─────────────┬─────────────┬─────────────┬─────────────╮
//      ___           ___           ___           ___           ___           ___               ___           ___           ___           ___           ___           ___
// // ├─────────────┼─────────────┼─────────────┼─────────────┼─────────────┼─────────────┤   ├─────────────┼─────────────┼─────────────┼─────────────┼─────────────┼─────────────┤
//      ___           ___           ___           ___           ___           ___               ___           ___           ___           ___           ___           ___
// // ├─────────────┼─────────────┼─────────────┼─────────────┼─────────────┼─────────────┤   ├─────────────┼─────────────┼─────────────┼─────────────┼─────────────┼─────────────┤
//      ___           ___           ___           ___           ___           ___               ___           ___           ___           ___           ___           ___
// // ╰───────────────────────────────────────────────────────┼─────────────┼─────────────┤   ├─────────────┼─────────────┼───────────────────────────────────────────────────────╯
//                                                ___           ___           ___               ___           ___           ___
// //                                           ╰─────────────┴─────────────┴─────────────╯   ╰─────────────┴─────────────┴─────────────╯